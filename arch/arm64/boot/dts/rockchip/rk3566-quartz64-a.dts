// SPDX-License-Identifier: (GPL-2.0+ OR MIT)

/dts-v1/;

#include "rk3566-quartz64.dtsi"

/ {
	model = "Pine64 RK3566 Quartz64-A Board";
	compatible = "pine64,quartz64-a", "rockchip,rk3566";

	aliases {
		mmc0 = &sdmmc0;
		mmc1 = &sdmmc1;
		mmc2 = &sdhci;
	};

	chosen: chosen {
		bootargs = "earlycon=uart8250,mmio32,0xfe660000";
		stdout-path = "serial2:1500000n8";
	};
};
